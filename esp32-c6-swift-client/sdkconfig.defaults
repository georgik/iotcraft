## esp32-p4-tab5-client/sdkconfig.defaults.m5stack_tab5
```kconfig
# M5Stack Tab5 ESP32-P4 Configuration
# - 5-inch 1280x720 IPS display via MIPI-DSI
# - GT911 touch controller
# - 16MB Flash, 32MB PSRAM
# - ESP32-P4 dual-core RISC-V
# This file was updated using idf.py save-defconfig to capture current configuration

# Board selection
CONFIG_SDL_BSP_M5STACK_TAB5=y

CONFIG_IDF_TARGET="esp32p4"
CONFIG_ESPTOOLPY_FLASHMODE_QIO=y
CONFIG_ESPTOOLPY_FLASHSIZE_16MB=y

# Partition table configuration
CONFIG_PARTITION_TABLE_CUSTOM=y

# Compiler optimization for performance
CONFIG_COMPILER_OPTIMIZATION_PERF=y
CONFIG_COMPILER_CXX_EXCEPTIONS=y

# PSRAM Configuration - CRITICAL for ESP32-P4 performance
# IMPORTANT: M5Stack Tab5 requires 200MHz SPIRAM speed for proper operation
# Default 20MHz is too slow and will cause display/performance issues
CONFIG_SPIRAM=y
CONFIG_SPIRAM_SPEED_200M=y
CONFIG_SPIRAM_USE_MALLOC=y
CONFIG_SPIRAM_MEMTEST=y
CONFIG_SPIRAM_MALLOC_ALWAYSINTERNAL=16384
CONFIG_SPIRAM_MALLOC_RESERVE_INTERNAL=32768
CONFIG_FREERTOS_TASK_CREATE_ALLOW_EXT_MEM=y

# Cache configuration for P4 - CRITICAL for graphics performance
CONFIG_CACHE_L2_CACHE_256KB=y
CONFIG_CACHE_L2_CACHE_LINE_128B=y

# FreeRTOS configuration
CONFIG_FREERTOS_HZ=1000

# Experimental features (required for ESP32-P4)
CONFIG_IDF_EXPERIMENTAL_FEATURES=y

# BSP specific configuration for M5Stack Tab5
# Display resolution 720x1280 via MIPI-DSI (portrait mode)
# Configuration is handled by the M5Stack Tab5 BSP component

# Disable LVGL in M5Stack Tab5 BSP (we're using SDL3)
CONFIG_BSP_CONFIG_NO_GRAPHIC_LIB=y
```

## iotcraft-gateway/sdkconfig.defaults.esp-box-3
```kconfig
# ESP32-S3-BOX-3 Configuration
# - 320x240 IPS display via SPI
# - Capacitive touch controller
# - 16MB Flash, 8MB PSRAM  
# - ESP32-S3 dual-core Xtensa

CONFIG_IDF_TARGET="esp32s3"
CONFIG_ESPTOOLPY_FLASHMODE_QIO=y
CONFIG_ESPTOOLPY_FLASHSIZE_16MB=y

# PSRAM Configuration
CONFIG_SPIRAM=y
CONFIG_SPIRAM_MODE_OCT=y
CONFIG_SPIRAM_SPEED_80M=y

# Compiler optimization for performance
CONFIG_COMPILER_OPTIMIZATION_PERF=y

# FreeRTOS configuration
CONFIG_FREERTOS_HZ=1000

# BSP specific configuration for ESP32-S3-BOX-3
# Display resolution 320x240 via SPI
CONFIG_BSP_LCD_RGB_BUFFER_NUMS=2
CONFIG_BSP_LCD_RGB_BOUNCE_BUFFER_MODE=y

# Required for SDL3 and TTF rendering
CONFIG_ESP_MAIN_TASK_STACK_SIZE=16000

# Enable experimental features for latest BSP
CONFIG_IDF_EXPERIMENTAL_FEATURES=y

# FreeRTOS configuration for task monitoring
CONFIG_FREERTOS_GENERATE_RUN_TIME_STATS=y
CONFIG_FREERTOS_USE_STATS_FORMATTING_FUNCTIONS=y

# USB Console configuration - keep USB working when WiFi is on
CONFIG_ESP_CONSOLE_USB_SERIAL_JTAG=y
CONFIG_ESP_CONSOLE_SECONDARY_USB_SERIAL_JTAG=y

# Disable LVGL in ESP-BOX-3 BSP (we're using SDL3)
# This is equivalent to BSP_CONFIG_NO_GRAPHIC_LIB=1
CONFIG_BSP_CONFIG_NO_GRAPHIC_LIB=y
```
